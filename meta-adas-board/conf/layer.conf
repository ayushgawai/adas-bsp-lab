## meta-adas-board/conf/layer.conf
```bitbake
BBPATH .= ":${LAYERDIR}"
BBFILES += "${LAYERDIR}/recipes-*/*/*.bb ${LAYERDIR}/recipes-*/*/*.bbappend"
BBFILE_COLLECTIONS += "meta-adas-board"
BBFILE_PATTERN_meta-adas-board = "^${LAYERDIR}/"
LAYERSERIES_COMPAT = "scarthgap"
```

## meta-adas-board/conf/machine/adas-virt.conf
```bitbake
# AArch64 virtual ADAS board (QEMU virt)
require conf/machine/include/arm/arch-armv8a.inc
MACHINE_FEATURES = "can i2c spi gpio ethernet"
KERNEL_IMAGETYPE = "Image"
PREFERRED_PROVIDER_virtual/kernel = "linux-yocto"
SERIAL_CONSOLES = "115200;ttyAMA0"
IMAGE_FSTYPES = "ext4 tar.gz"
QEMU_SYSTEM_NAME = "qemu-system-aarch64"
QB_MACHINE = "-machine virt"
QB_CPU = "-cpu cortex-a57"
QB_MEM = "-m 1024"
```
